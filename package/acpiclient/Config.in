## package/acpiclient/Config.in
```kconfig
config BR2_PACKAGE_ACPICLIENT
	bool "acpiclient"
	depends on BR2_x86_64 || BR2_i386
	help
	  Advanced Configuration and Power Interface client tool.

	  http://sourceforge.net/projects/acpiclient/
```

## package/dunst/Config.in
```kconfig
config BR2_PACKAGE_DUNST
	bool "dunst"
	depends on BR2_PACKAGE_XORG7
	select BR2_PACKAGE_LIBGLIB2
	select BR2_PACKAGE_DBUS
	select BR2_PACKAGE_CAIRO
	select BR2_PACKAGE_CAIRO_PNG
	select BR2_PACKAGE_PANGO
	select BR2_PACKAGE_GDK_PIXBUF
	select BR2_PACKAGE_LIBNOTIFY
	select BR2_PACKAGE_LIBXDG_BASEDIR
	select BR2_PACKAGE_XLIB_LIBXINERAMA
	select BR2_PACKAGE_XLIB_LIBXRANDR
	select BR2_PACKAGE_XLIB_LIBXSCRNSAVER
	help
	  Lightweight desktop notifications.

	  https://dunst-project.org/
```

## package/fs-uae/Config.in
```kconfig
config BR2_PACKAGE_FS_UAE
	bool "fs-uae"
	select BR2_PACKAGE_SDL2
	select BR2_PACKAGE_LIBGLEW
	help
	  Ubiquitous Amiga Emulator

	  https://github.com/FrodeSolheim/fs-uae
```

## package/i3/Config.in
```kconfig
config BR2_PACKAGE_I3
	bool "i3"
	depends on BR2_PACKAGE_XORG7
	select BR2_PACKAGE_LIBEV
	select BR2_PACKAGE_LIBXCB
	select BR2_PACKAGE_LIBXKBCOMMON
	select BR2_PACKAGE_CAIRO
	select BR2_PACKAGE_PANGO
	select BR2_PACKAGE_PCRE
	select BR2_PACKAGE_STARTUP_NOTIFICATION
	select BR2_PACKAGE_YAJL
	select BR2_PACKAGE_XCB_UTIL
	select BR2_PACKAGE_XCB_UTIL_CURSOR
	select BR2_PACKAGE_XCB_UTIL_KEYSYMS
	select BR2_PACKAGE_XCB_UTIL_WM
	select BR2_PACKAGE_XCB_UTIL_XRM
	help
	  The improved tiling window manager.

	  http://i3wm.org/
```

## package/i3lock/Config.in
```kconfig
config BR2_PACKAGE_I3LOCK
	bool "i3lock"
	depends on BR2_PACKAGE_XORG7
	select BR2_PACKAGE_CAIRO
	select BR2_PACKAGE_LIBEV
	select BR2_PACKAGE_LIBXCB
	select BR2_PACKAGE_LIBXKBCOMMON
	select BR2_PACKAGE_XCB_UTIL
	select BR2_PACKAGE_XCB_UTIL_IMAGE
	help
	  Screen locker intended for the i3 window manager.

	  http://i3wm.org/i3lock/
```

## package/kbd/Config.in
```kconfig
config BR2_PACKAGE_KBD
	bool "kbd"
	# Required for usage
	select BR2_PACKAGE_GZIP
	# Uses fork()
	depends on BR2_USE_MMU
	help
	  Keytable files and keyboard utilities.

	  http://kernel.org/pub/linux/utils/kbd/
```

## package/libnotify/Config.in
```kconfig
config BR2_PACKAGE_LIBNOTIFY
	bool "libnotify"
	depends on BR2_PACKAGE_XORG7
	select BR2_PACKAGE_LIBGLIB2
	select BR2_PACKAGE_GDK_PIXBUF
	help
	  Notification system library.

	  https://github.com/GNOME/libnotify
```

## package/libxdg-basedir/Config.in
```kconfig
config BR2_PACKAGE_LIBXDG_BASEDIR
	bool "libxdg-basedir"
	depends on BR2_PACKAGE_XORG7
	help
	  An implementation of the XDG Base Directory specifications

	  https://github.com/devnev/libxdg-basedir/
```

## package/simh/Config.in
```kconfig
config BR2_PACKAGE_SIMH
	bool "simh"
	depends on BR2_PACKAGE_PCRE
	help
	  Simulator of historic computing systems.

	  https://github.com/simh/simh

if BR2_PACKAGE_SIMH

config BR2_PACKAGE_SIMH_SELECTED
	bool "Select specific simulators"
	help
	  Select simulators to be built.

if BR2_PACKAGE_SIMH_SELECTED
config BR2_PACKAGE_SIMH_SIMULATORS
	string "Simulators to build and install"
	help
	  List of simulators to install.

	  Use uppercase names (VAX650, PDP11...).
endif # BR2_PACKAGE_SIMH_SELECTED

config BR2_PACKAGE_SIMH_GRAPHICS
	bool "Enable graphics support"
	select BR2_PACKAGE_SDL
	help
	  Enable support for graphics in some simulators.

config BR2_PACKAGE_SIMH_NETWORK
	bool "Enable network support"
	select BR2_PACKAGE_VDEPLUG
	help
	  Enable support for networking in some simulators.

endif # BR2_PACKAGE_SIMH
```

## package/systemd-xlogin/Config.in
```kconfig
config BR2_PACKAGE_SYSTEMD_XLOGIN
	bool "systemd-xlogin"
	depends on BR2_INIT_SYSTEMD
	depends on BR2_PACKAGE_BASH
	depends on BR2_PACKAGE_XORG7
	help
	  Makes it possible to login to X without a desktop manager.

	  https://github.com/joukewitteveen/xlogin
```

## package/tcc/Config.in
```kconfig
config BR2_PACKAGE_TCC
	bool "tcc"
	help
	  Tiny C Compiler

	  https://bellard.org/tcc/
```

## package/x11r7/xcb-util-xrm/Config.in
```kconfig
config BR2_PACKAGE_XCB_UTIL_XRM
	bool "xcb-util-xrm"
	select BR2_PACKAGE_XCB_UTIL
	help
	  XCB utility functions for the X resource manager

	  https://github.com/Airblader/xcb-util-xrm
```

## package/xautolock/Config.in
```kconfig
config BR2_PACKAGE_XAUTOLOCK
	bool "xautolock"
	depends on BR2_PACKAGE_XORG7
	select BR2_PACKAGE_XUTIL_IMAKE
	select BR2_PACKAGE_XLIB_LIBX11
	select BR2_PACKAGE_XLIB_LIBXAU
	select BR2_PACKAGE_XLIB_LIBXDMCP
	select BR2_PACKAGE_XLIB_LIBXEXT
	select BR2_PACKAGE_XLIB_LIBXSCREENSAVER
	help
	  Screen lock timer.
```
